## leveldb/qemu.x86_64.defconfig
```kconfig
CONFIG_UK_NAME="leveldb"
CONFIG_ARCH_X86_64=y
CONFIG_PLAT_KVM=y
CONFIG_STACK_SIZE_PAGE_ORDER=6
CONFIG_LIBUKPRINT_KLVL_INFO=y
CONFIG_APPLEVELDB=y
CONFIG_OPTIMIZE_PERF=y
CONFIG_DEBUG_SYMBOLS_LVL1=y
```

## rocksdb/fc.arm64.defconfig
```kconfig
CONFIG_UK_NAME="rocksdb"
CONFIG_ARCH_ARM_64=y
CONFIG_PLAT_KVM=y
CONFIG_KVM_VMM_FIRECRACKER=y
CONFIG_STACK_SIZE_PAGE_ORDER=6
CONFIG_LIBVFSCORE_AUTOMOUNT_ROOTFS=y
CONFIG_LIBVFSCORE_ROOTFS_INITRD=y
CONFIG_LIBUKPRINT_KLVL_INFO=y
CONFIG_APPROCKSDB=y
CONFIG_OPTIMIZE_PERF=y
CONFIG_DEBUG_SYMBOLS_LVL1=y
```
